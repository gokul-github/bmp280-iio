/*
 * I²C controller on the ARM Versatile/PB board, with a BMP280 at 0x76.
 * Merge this into arch/arm/boot/dts/arm/versatile-pb.dts (the stock node
 * is i2c@10002000, compatible "arm,versatile-i2c"). 0x76 means SDO is
 * grounded. Use reg = <0x77> if QEMU created the slave at address 0x77.
 *
 * The guest kernel probes this through of_i2c, matching the driver's
 * of_device_id table on "bosch,bmp280". No userspace i2c_new_device needed.
 */
i2c@10002000 {
	compatible = "arm,versatile-i2c";
	reg = <0x10002000 0x1000>;
	#address-cells = <1>;
	#size-cells = <0>;

	bmp280@76 {
		compatible = "bosch,bmp280";
		reg = <0x76>;
	};
};
